## app/boards/arm/hs22k/Kconfig
```kconfig
# Copyright (c) 2022 Daniel Grenehed
# SPDX-License-Identifier: MIT

config BOARD_ENABLE_DCDC
	bool "Enable DCDC mode"
	select SOC_DCDC_NRF52X
	default y
	depends on BOARD_HS22K

CONFIG_ZMK_COMBO_MAX_PRESSED_COMBOS=6
COMFIG_ZMK_COMBO_MAX_COMBOS_PER_KEY=10
CONFIG_ZMK_COMBO_MAX_KEYS_PER_COMBO=6
```

## app/boards/arm/hs22k/Kconfig.board
```kconfig
# Copyright (c) 2022 Daniel Grenehed
# SPDX-License-Identifier: MIT

config BOARD_HS22K
	bool "hs22k"
	depends on SOC_NRF52840_QIAA
```

## app/boards/arm/hs22k/Kconfig.defconfig
```kconfig
# Copyright (c) 2022 Daniel Grenehed
# SPDX-License-Identifier: MIT

if BOARD_HS22K

config ZMK_KEYBOARD_NAME
	default "hs22k"

if USB

config USB_NRFX
	default y

config USB_DEVICE_STACK
	default y

endif # USB

config BT_CTLR
	default BT

config ZMK_BLE
	default y

config ZMK_USB
	default y

config ZMK_BATTERY_VOLTAGE_DIVIDER
	default y

CONFIG_ZMK_COMBO_MAX_PRESSED_COMBOS=6
COMFIG_ZMK_COMBO_MAX_COMBOS_PER_KEY=10
CONFIG_ZMK_COMBO_MAX_KEYS_PER_COMBO=6
endif # BOARD_HS22K
```

## app/boards/arm/hs22k/hs22k_defconfig
```kconfig
# Copyright (c) 2022 Daniel Grenehed
# SPDX-License-Identifier: MIT

CONFIG_SOC_SERIES_NRF52X=y
CONFIG_SOC_NRF52840_QIAA=y
CONFIG_BOARD_HS22K=y

# Enable MPU
CONFIG_ARM_MPU=y

# enable GPIO
CONFIG_GPIO=y

CONFIG_USE_DT_CODE_PARTITION=y

CONFIG_MPU_ALLOW_FLASH_WRITE=y
CONFIG_NVS=y
CONFIG_SETTINGS_NVS=y
CONFIG_FLASH=y
CONFIG_FLASH_PAGE_LAYOUT=y
CONFIG_FLASH_MAP=y

CONFIG_ZMK_RGB_UNDERGLOW_HUE_START=160
CONFIG_ZMK_RGB_UNDERGLOW_EFF_START=3

CONFIG_ZMK_COMBO_MAX_PRESSED_COMBOS=6
CONFIG_ZMK_COMBO_MAX_COMBOS_PER_KEY=10
CONFIG_ZMK_COMBO_MAX_KEYS_PER_COMBO=6
```

## app/boards/shields/s22k/Kconfig.defconfig
```kconfig
if SHIELD_S22K_LEFT

config ZMK_KEYBOARD_NAME
    default "S22K"

config ZMK_SPLIT_ROLE_CENTRAL
    default y

endif

if SHIELD_S22K_LEFT || SHIELD_S22K_RIGHT

config ZMK_SPLIT
    default y

endif
```

## app/boards/shields/s22k/Kconfig.shield
```kconfig
config SHIELD_S22K_LEFT
    def_bool $(shields_list_contains,s22k_left)

config SHIELD_S22K_RIGHT
    def_bool $(shields_list_contains,s22_right)
```
